## src/examples/lhx_test_module/Kconfig
```kconfig
menuconfig EXAMPLES_LHX_TEST_MODULE
	bool "lhx_test_module"
	default n
	---help---
		Enable support for lhx_test_module
```

## src/modules/lhx_test/Kconfig
```kconfig
menuconfig MODULES_LHX_TEST
	bool "lhx_test"
	default n
	---help---
		Enable support for lhx_test
```
